# AST1060 register map
File version: 1.0
CPU: CM4 r0p1, little endian, MPU, FPU, 4 interrupt priority bits
Registers are 32-bit, read-write, reset 0x0 unless marked. A register's access mark holds for its fields unless they carry their own. Offsets are from the block's base; lines under a group give offsets from that group; [hi:lo] are bit positions; {n}, {i} and the like mark numbered series; 'fields as' and 'values as' point back to an identical list; <NAME> marks a mode.

## Memory map
0x40000000 UART1
0x50000000 UART2
0x7E6D0000 HACE

## Interrupts
5 UART1
7 UART2

## UART1
Base 0x40000000
Same registers: UART2 0x50000000
0x00 RBR ro — Receiving Buffer Register
0x00 THR wo — Transmit Holding Register
0x04 IER — Interrupt Enable Register
0x04 DLL — Divisor Latch Low Register
0x08 IIR ro — Interrupt Identity Register
0x08 DLH — Divisor Latch High Register
0x0C FCR wo — FIFO Control Register
0x10 LCR — Line Control Register
0x14 MCR — Modem Control Register
0x18 LSR ro — Line Status Register
0x1C MSR ro — Modem Status Register
0x20 SCR — Scratch Register

## HACE
Base 0x7E6D0000
0x00 HACE00 — Crypto Data Source Base Address Register
  [31:0] BASE_ADDRESS — Base address of crypto source data

## Notices in the file
Copyright (c) 2025 ASPEED Technology.
SPDX-License-Identifier: Apache-2.0
Licensed under the Apache License, Version 2.0 (the "License");
you may not use this file except in compliance with the License.
You may obtain a copy of the License at
http://www.apache.org/licenses/LICENSE-2.0
Unless required by applicable law or agreed to in writing, software
distributed under the License is distributed on an "AS IS" BASIS,
WITHOUT WARRANTIES OR CONDITIONS OF ANY KIND, either express or
implied. See the License for the specific language governing
permissions and limitations under the License.
